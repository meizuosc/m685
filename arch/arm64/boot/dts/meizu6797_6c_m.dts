/dts-v1/;

#include "mt6797.dtsi"

/ {
	memory@40000000 {
		device_type = "memory";
		reg = <0 0x40000000 0 0x1e605000>;
	};

	reserved-memory {
		#address-cells = <2>;
		#size-cells = <2>;
		ranges;

		memory-lowpower-reserved-memory {
			compatible = "mediatek,memory-lowpower";
			size = <0 0x40000000>;
			alloc-ranges = <0 0xc0000000 0 0x80000000>;
		};
	};

	/* chosen */
	chosen {
		bootargs = "console=tty0 console=ttyMT0,921600n1 root=/dev/ram initrd=0x44000000,0x4B434E loglevel=8";
		/* fpga may has no lk, we need to specify display info here */
		/* fb buffer is reserved using this dts by memory node above */
		atag,videolfb-fb_base_h = <0x0>;
		atag,videolfb-fb_base_l = <0x5e605000>;
		atag,videolfb-islcmfound = <1>;
		/* because no lk, so lcm is not inited */
		atag,videolfb-islcm_inited = <0>;
		atag,videolfb-fps= <6000>;
		atag,videolfb-vramSize= <0x017bb000>;
		atag,videolfb-lcmname= "ft8716_fhd_vdo_sharp";
		/*use sysrq reset function for usb-uart switch, HOME + Vol UP + Vol+DOWN*/
		linux,sysrq-reset-seq {
			keyset = <102 114 115>;
			timeout-ms = <15000>;
		};
	};


	soc {
		compatible = "simple-bus";
		#address-cells = <1>;
		#size-cells = <1>;
		ranges = <0 0 0 0xffffffff>;

		mmc0_pins_default: mmc0@default {
			pins_cmd {
				drive-strength = /bits/ 8 <1>;
			};
			pins_dat {
				drive-strength = /bits/ 8 <1>;
			};
			pins_clk {
				drive-strength = /bits/ 8 <1>;
			};
			pins_rst {
				drive-strength = /bits/ 8 <1>;
			};
			pins_ds {
				drive-strength = /bits/ 8 <1>;
			};
		};

		mmc0_register_setting_default: mmc0@register_default {
			dat0rddly      = /bits/ 8 <0>;
			dat1rddly      = /bits/ 8 <0>;
			dat2rddly      = /bits/ 8 <0>;
			dat3rddly      = /bits/ 8 <0>;
			dat4rddly      = /bits/ 8 <0>;
			dat5rddly      = /bits/ 8 <0>;
			dat6rddly      = /bits/ 8 <0>;
			dat7rddly      = /bits/ 8 <0>;
			datwrddly      = /bits/ 8 <0>;
			cmdrrddly      = /bits/ 8 <0>;
			cmdrddly       = /bits/ 8 <0>;
			cmd_edge = /bits/ 8 <MSDC_SMPL_FALLING>;
			rdata_edge = /bits/ 8 <MSDC_SMPL_FALLING>;
			wdata_edge = /bits/ 8 <MSDC_SMPL_FALLING>;
		};

		mmc1_pins_default: mmc1@default {
			   pins_cmd {
				   drive-strength = /bits/ 8 <6>;
			   };
			   pins_dat {
				   drive-strength = /bits/ 8 <6>;
			   };
			   pins_clk {
				   drive-strength = /bits/ 8 <6>;
			   };
		};

		mmc1_pins_sdr104: mmc1@sdr104 {
			  pins_cmd {
				  drive-strength = /bits/ 8 <3>;
			  };
			  pins_dat {
				  drive-strength = /bits/ 8 <3>;
			  };
			  pins_clk {
				  drive-strength = /bits/ 8 <4>;
			  };
		};

		mmc1_pins_sdr50: mmc1@sdr50 {
			 pins_cmd {
				 drive-strength = /bits/ 8 <3>;
			 };
			 pins_dat {
				 drive-strength = /bits/ 8 <3>;
			 };
			 pins_clk {
				 drive-strength = /bits/ 8 <4>;
			 };
		};

		mmc1_pins_ddr50: mmc1@ddr50 {
			 pins_cmd {
				 drive-strength = /bits/ 8 <3>;
			 };
			 pins_dat {
				 drive-strength = /bits/ 8 <3>;
			 };
			 pins_clk {
				 drive-strength = /bits/ 8 <4>;
			 };
		 };

		mmc1_register_setting_default: mmc1@register_default {
				       dat0rddly      = /bits/ 8 <0>;
				       dat1rddly      = /bits/ 8 <0>;
				       dat2rddly      = /bits/ 8 <0>;
				       dat3rddly      = /bits/ 8 <0>;
				       datwrddly      = /bits/ 8 <0>;
				       cmdrrddly      = /bits/ 8 <0>;
				       cmdrddly       = /bits/ 8 <0>;
				       cmd_edge = /bits/ 8 <MSDC_SMPL_FALLING>;
				       rdata_edge = /bits/ 8 <MSDC_SMPL_FALLING>;
				       wdata_edge = /bits/ 8 <MSDC_SMPL_FALLING>;
		};

		tpvddi_gpio: tpvddi {
			compatible = "pinctrl-regulator";
		};
		lcd_bias_enp_gpio: lcd_enp {
			compatible = "pinctrl-regulator";
		};
		lcd_bias_enn_gpio: lcd_enn {
			compatible = "pinctrl-regulator";
		};
	};

	led0:led@0 {
		compatible = "mediatek,red";
		led_mode = <0>;
		data = <1>;
		pwm_config = <0 0 0 0 0>;
	};
	led1:led@1 {
		compatible = "mediatek,green";
		led_mode = <0>;
		data = <1>;
		pwm_config = <0 0 0 0 0>;
	};
	led2:led@2 {
		compatible = "mediatek,blue";
		led_mode = <0>;
		data = <1>;
		pwm_config = <0 0 0 0 0>;
	};
	led3:led@3 {
		compatible = "mediatek,jogball-backlight";
		led_mode = <0>;
		data = <1>;
		pwm_config = <0 0 0 0 0>;
	};
	led4:led@4 {
		compatible = "mediatek,keyboard-backlight";
		led_mode = <0>;
		data = <1>;
		pwm_config = <0 0 0 0 0>;
	};
	led5:led@5 {
		compatible = "mediatek,button-backlight";
		led_mode = <3>;
		data = <1>;
		pwm_config = <0 0 0 0 0>;
	};
	led6:led@6 {
		compatible = "mediatek,lcd-backlight";
		led_mode = <4>;
		data = <1>;
		pwm_config = <0 0 0 0 0>;
	};
	vibrator0:vibrator@0 {
		compatible = "mediatek,vibrator";
		vib_timer = <25>;
		vib_limit = <9>;
		vib_vol= <5>;
	};
/* sensor standardization */
	cust_accel@0 {
		compatible				= "mediatek,icm20645g";
		i2c_num					= <1>;
		i2c_addr				= <0x68 0 0 0>;
		direction				= <3>;
		power_id				= <0xffff>;
		power_vol				= <0>;
		firlen					= <0>;
		is_batch_supported		= <0>;
	};

	cust_alsps@0 {
		compatible				= "mediatek,cm36558";
		i2c_num					= <1>;
		i2c_addr				= <0x51 0 0 0>;
		polling_mode_ps			= <0>;
		polling_mode_als		= <1>;
		power_id				= <0xffff>;
		power_vol				= <0>;
		als_level = <0 328 861 1377 3125 7721 7767 12621 23062 28430 33274 47116 57694 57694 65535>;
		als_value = <0 133 304 502 1004 2005 3058 5005 8008 10010 12000 16000 20000 20000 20000 20000>;
		ps_threshold_high		= <26>;
		ps_threshold_low		= <21>;
		is_batch_supported_ps	= <0>;
		is_batch_supported_als	= <0>;
	};

	cust_mag@0 {
		compatible				= "mediatek,akm09912";
		i2c_num					= <1>;
		i2c_addr				= <0x0C 0 0 0>;
		direction				= <7>;
		power_id				= <0xffff>;
		power_vol				= <0>;
		is_batch_supported		= <0>;
	};

	cust_gyro@0 {
		compatible				= "mediatek,icm20645gy";
		i2c_num					= <1>;
		i2c_addr				= <0x69 0 0 0>;
		direction				= <3>;
		power_id				= <0xffff>;
		power_vol				= <0>;
		firlen					= <0>;
		is_batch_supported		= <0>;
	};

	cust_baro@0 {
		compatible				= "mediatek,bmp280";
		i2c_num					= <1>;
		i2c_addr				= <0x77 0 0 0>;
		direction				= <0>;
		power_id				= <0xffff>;
		power_vol				= <0>;
		firlen					= <0>;
		is_batch_supported		= <0>;
	};

	cust_hmdy@0 {
		compatible				= "mediatek,hts221";
		i2c_num					= <1>;
		i2c_addr				= <0x5f 0 0 0>;
		direction				= <0>;
		power_id				= <0xffff>;
		power_vol				= <0>;
		firlen					= <0>;
		is_batch_supported		= <0>;
	};
};
/* sensor gpio standization */
&pio {
	alsps_intpin_cfg: alspspincfg {

	    pins_cmd_dat {
			pins = <PINMUX_GPIO85__FUNC_EINT8>;
			slew-rate = <0>;
			bias-pull-up = <00>;
		};
	};

	alsps_intpin_default: alspsdefaultcfg {

	};

	gyro_intpin_cfg: gyropincfg {

	    pins_cmd_dat {
			pins = <PINMUX_GPIO63__FUNC_EINT2>;
			slew-rate = <0>;
			bias-pull-down = <00>;
		};
	};

	gyro_intpin_default: gyrodefaultcfg {

	};
};
&als {
	pinctrl-names = "pin_default", "pin_cfg";
	pinctrl-0 = <&alsps_intpin_default>;
	pinctrl-1 = <&alsps_intpin_cfg>;
	status = "okay";

};

&gyro {
	pinctrl-names = "pin_default", "pin_cfg";
	pinctrl-0 = <&gyro_intpin_default>;
	pinctrl-1 = <&gyro_intpin_cfg>;
	status = "okay";

};
/* sensor end */

&apuart0 {
	pinctrl-names = "uart0_gpio_default",
			"uart0_rx_set",
			"uart0_rx_clear",
			"uart0_tx_set",
			"uart0_tx_clear";

	pinctrl-0 = <&uart0_gpio_def_cfg>;
	pinctrl-1 = <&uart0_rx_set_cfg>;
	pinctrl-2 = <&uart0_rx_clr_cfg>;
	pinctrl-3 = <&uart0_tx_set_cfg>;
	pinctrl-4 = <&uart0_tx_clr_cfg>;
	status = "okay";
};

&apuart1 {
	/*
	pinctrl-names = "uart1_gpio_default",
			"uart1_rx_set",
			"uart1_rx_clear",
			"uart1_tx_set",
			"uart1_tx_clear";

	pinctrl-0 = <&uart1_gpio_def_cfg>;
	pinctrl-1 = <&uart1_rx_set_cfg>;
	pinctrl-2 = <&uart1_rx_clr_cfg>;
	pinctrl-3 = <&uart1_tx_set_cfg>;
	pinctrl-4 = <&uart1_tx_clr_cfg>;
	status = "okay";
	*/
};

&pio {
	/* UART GPIO Settings - Start */
	/* UART0: rx set, rx clear, tx clear, tx clear*/
	uart0_gpio_def_cfg:uart0gpiodefault {
	};
	uart0_rx_set_cfg:uart0_rx_set@gpio97 {
		pins_cmd_dat {
			pins = <PINMUX_GPIO97__FUNC_URXD0>;
		};
	};
	uart0_rx_clr_cfg:uart0_rx_clear@gpio97  {
		pins_cmd_dat {
			pins = <PINMUX_GPIO97__FUNC_GPIO97>;
			slew-rate = <1>;
			output-high;
		};
	};
	uart0_tx_set_cfg:uart0_tx_set@gpio98  {
		pins_cmd_dat {
			pins = <PINMUX_GPIO98__FUNC_UTXD0>;
		};
	};
	uart0_tx_clr_cfg:uart0_tx_clear@gpio98  {
		pins_cmd_dat {
			pins = <PINMUX_GPIO98__FUNC_GPIO98>;
			slew-rate = <1>;
			output-high;
		};
	};
	/* UART1: rx set, rx clear, tx clear, tx clear*/
	/*
	uart1_gpio_def_cfg:uart1gpiodefault {
	};
	uart1_rx_set_cfg:uart1_rx_set@gpio232 {
		pins_cmd_dat {
			pins = <PINMUX_GPIO232__FUNC_URXD1>;
		};
	};
	uart1_rx_clr_cfg:uart1_rx_clear@gpio232 {
		pins_cmd_dat {
			pins = <PINMUX_GPIO232__FUNC_GPIO232>;
			slew-rate = <1>;
			output-high;
		};
	};
	uart1_tx_set_cfg:uart1_tx_set@gpio233 {
		pins_cmd_dat {
			pins = <PINMUX_GPIO233__FUNC_UTXD1>;
		};
	};
	uart1_tx_clr_cfg:uart1_tx_clear@gpio233 {
		pins_cmd_dat {
			pins = <PINMUX_GPIO233__FUNC_GPIO233>;
			slew-rate = <1>;
			output-high;
		};
	};
	*/
	/* UART GPIO Settings - End */
};

&spi1 {
	#address-cells = <1>;
	#size-cells = <0>;

	fingerprint_gf@0 {
		compatible = "goodix,goodix-fp";
		reg = <0>;
		spi-max-frequency = <8000000>;
		netlink-event = <26>;
		status = "okay";
	};
};

/* FINGERPRINT start */
&fingerprint {
	pinctrl-names = "default", "miso_spi", "miso_pullhigh", "miso_pulllow", "reset_high", "reset_low";
	pinctrl-0 = <&fingerprint_default>;
	pinctrl-1 = <&fingerprint_miso_spi>;
	pinctrl-2 = <&fingerprint_miso_pullhigh>;
	pinctrl-3 = <&fingerprint_miso_pulllow>;
	pinctrl-4 = <&fingerprint_reset_high>;
	pinctrl-5 = <&fingerprint_reset_low>;
	status = "okay";
};

&pio {
	fingerprint_default: state_default {

	};

	fingerprint_miso_spi: state_miso_spi {
		pins_cmd_dat {
			pins = <PINMUX_GPIO235__FUNC_SPI1_MI_B>;
		};
	};

	fingerprint_miso_pullhigh: state_miso_pullhigh {
		pins_cmd_dat {
			pins = <PINMUX_GPIO235__FUNC_GPIO235>;
			slew-rate = <1>;
			output-high;
		};
	};

	fingerprint_miso_pulllow: state_miso_pulllow {
		pins_cmd_dat {
			pins = <PINMUX_GPIO235__FUNC_GPIO235>;
			slew-rate = <1>;
			output-low;
		};
	};

	fingerprint_reset_high: state_reset_high {
		pins_cmd_dat {
			pins = <PINMUX_GPIO253__FUNC_GPIO253>;
			slew-rate = <1>;
			output-high;
		};
	};

	fingerprint_reset_low: state_reset_low {
		pins_cmd_dat {
			pins = <PINMUX_GPIO253__FUNC_GPIO253>;
			slew-rate = <1>;
			output-low;
		};
	};
};
/* FINGERPRINT end */

/* NFC GPIO standardization */
/* NFC end */

&touch {
	irq-gpio = <&pio 68 0>;
	irq-flags = <0x2008>; /* IRQF_ONESHOT | IRQF_TRIGGER_LOW */
	vtouch-supply = <&tpvddi_gpio>;
	lcd_bias_enp-supply = <&lcd_bias_enp_gpio>;
	lcd_bias_enn-supply = <&lcd_bias_enn_gpio>;
/*	power-gpio = <&pio 201 0>;
	power-delay-ms = <160>;*/
	reset-gpio = <&pio 211 0>;
	reset-delay-ms = <100>;
	reset-active-ms = <20>;
	wake-gpio = <&pio 67 0>;
	tpd-resolution = <1080 1920>;
	use-tpd-button = <0>;
	tpd-max-touch-num = <5>;
	tpd-filter-enable = <1>;
	tpd-filter-pixel-density = <192>;
	tpd-filter-custom-prameters = <0 0 0 0 0 0 0 0 0 0 0 0>;
	tpd-filter-custom-speed = <0 0 0>;
	pinctrl-names = "default", "state_eint_as_int", "state_eint_output0", "state_eint_output1",
		"state_rst_output0", "state_rst_output1";
	pinctrl-0 = <&ctp_pins_default>;
	pinctrl-1 = <&ctp_pins_eint_as_int>;
	pinctrl-2 = <&ctp_pins_eint_output0>;
	pinctrl-3 = <&ctp_pins_eint_output1>;
	pinctrl-4 = <&ctp_pins_rst_output0>;
	pinctrl-5 = <&ctp_pins_rst_output1>;
	status = "okay";
};
&pio {
	ctp_pins_default: eint0default {
	};
	ctp_pins_eint_as_int: eint@0 {
		pins_cmd_dat {
			pins = <PINMUX_GPIO68__FUNC_EINT7>;
			slew-rate = <0>;
			bias-pull-up = <00>;
		};
	};
	ctp_pins_eint_output0: eintoutput0 {
		pins_cmd_dat {
			pins = <PINMUX_GPIO68__FUNC_GPIO68>;
			slew-rate = <0>;
			bias-pull-down = <00>;
		};
	};
	ctp_pins_eint_output1: eintoutput1 {
		pins_cmd_dat {
			pins = <PINMUX_GPIO68__FUNC_GPIO68>;
			slew-rate = <0>;
			bias-pull-up = <00>;
		};
	};
	ctp_pins_rst_output0: rstoutput0 {
		pins_cmd_dat {
			pins = <PINMUX_GPIO211__FUNC_GPIO211>;
			slew-rate = <1>;
			output-low;
		};
	};
	ctp_pins_rst_output1: rstoutput1 {
		pins_cmd_dat {
			pins = <PINMUX_GPIO211__FUNC_GPIO211>;
			slew-rate = <1>;
			output-high;
		};
	};
};

/* TOUCH end */
&accdet {
		accdet-mic-vol = <7>;
		headset-mode-setting = <0x500 0x500 1 0x1F0 0x800 0x800 0x20>;
		accdet-plugout-debounce = <1>;
		/*1:ACC mode, 2:low cost without in bias, 6:low cost with in bias*/
		accdet-mic-mode = <1>;
		/*0--MD_MAX--UP_MAX--DW_MAX*/
		headset-three-key-threshold = <0 90 170 500>;
		/*0--MD_MAX--VOICE_MAX--UP_MAX--DW_MAX*/
		headset-four-key-threshold = <0 58 121 192 400>;
		/* ACCDET GPIO standardization ACC mode use */
		pinctrl-names = "default", "state_eint_as_int";
		pinctrl-0 = <&accdet_pins_default>;
		pinctrl-1 = <&accdet_pins_eint_as_int>;
		status = "okay";
};
&pio {
	accdet_pins_default: accdetdefault {
	};
	accdet_pins_eint_as_int: accdeteint@0 {
		pins_cmd_dat {
			pins = <PINMUX_GPIO92__FUNC_EINT15>;
			slew-rate = <0>;
			bias-disable;
		};
	};
};
/*ACCDET end*/
/* mmc start */
&mmc0 {
		clk_src = /bits/ 8 <MSDC0_CLKSRC_400MHZ>;
		bus-width = <8>;
		max-frequency = <200000000>;
		cap-mmc-highspeed;
		msdc-sys-suspend;
		mmc-ddr-1_8v;
		mmc-hs200-1_8v;
		mmc-hs400-1_8v;
		non-removable;
		pinctl = <&mmc0_pins_default>;
		register_setting = <&mmc0_register_setting_default>;
		host_function = /bits/ 8 <MSDC_EMMC>;
		bootable;
		status = "okay";
};

&mmc1 {
		clk_src = /bits/ 8 <MSDC1_CLKSRC_200MHZ>;
		bus-width = <4>;
		max-frequency = <200000000>;
		msdc-sys-suspend;
		cap-sd-highspeed;
		sd-uhs-sdr12;
		sd-uhs-sdr25;
		sd-uhs-sdr50;
		sd-uhs-sdr104;
		/* sd-uhs-ddr50;*/
		pinctl = <&mmc1_pins_default>;
		pinctl_sdr104 = <&mmc1_pins_sdr104>;
		pinctl_sdr50 = <&mmc1_pins_sdr50>;
		pinctl_ddr50 = <&mmc1_pins_ddr50>;
		register_setting = <&mmc1_register_setting_default>;
		host_function = /bits/ 8 <MSDC_SD>;
		cd_level = /bits/ 8 <MSDC_CD_LOW>;
		cd-gpios = <&pio 67 0>;
		status = "disabled";
};

&gpio {
	pinctrl-names = "system_setup_default","system_suspend","system_resume";
        pinctrl-0 = <&default_configuration>;
        pinctrl-1 = <&suspend_configuration>;
        pinctrl-2 = <&resume_configuration>;
        status = "okay";
};
/* System suspend GPIO configuration */

&pio {
	default_configuration: default_configuration{

	};
	suspend_configuration: suspend_configuration{
		/* HW version id pin */
		pins_cmd1_dat {
			pins = <PINMUX_GPIO39__FUNC_GPIO39>;
			slew-rate = <0>;
			bias-disable;
		};
		pins_cmd2_dat {
			pins = <PINMUX_GPIO40__FUNC_GPIO40>;
			slew-rate = <0>;
			bias-disable;
		};
		pins_cmd3_dat {
			pins = <PINMUX_GPIO41__FUNC_GPIO41>;
			slew-rate = <0>;
			bias-disable;
		};
		pins_cmd4_dat {
			pins = <PINMUX_GPIO42__FUNC_GPIO42>;
			slew-rate = <0>;
			bias-disable;
		};
		/* VDRAM external buck i2c pin */
		pins_cmd5_dat {
			pins = <PINMUX_GPIO53__FUNC_GPIO53>;
			slew-rate = <0>;
			bias-disable;
		};
		pins_cmd6_dat {
			pins = <PINMUX_GPIO54__FUNC_GPIO54>;
			slew-rate = <0>;
			bias-disable;
		};
		/* PA22403001 INT pin  */
		pins_cmd7_dat {
			pins = <PINMUX_GPIO90__FUNC_GPIO90>;
			slew-rate = <0>;
			bias-disable;
		};
	};
	resume_configuration: resume_configuration{
		/* PA22403001 INT pin  */
		pins_cmd7_dat {
			pins = <PINMUX_GPIO90__FUNC_EINT13>;
			bias-pull-up = <00>;
		};

	};
};

/* AUDIO GPIO standardization */
&audgpio {
	pinctrl-names = "aud_clk_mosi_off",
			"aud_clk_mosi_on",
			"aud_smartpa_mode0",
			"aud_smartpa_mode1",
			"aud_smartpa_mode3",
			"aud_tdm_mode0",
			"aud_tdm_mode1",
			"hpdepop-pullhigh",
			"hpdepop-pulllow",
			"aud_dat_miso_off",
			"aud_dat_miso_on",
			"aud_dat_mosi_off",
			"aud_dat_mosi_on",
			"vow_dat_miso_off",
			"vow_dat_miso_on",
			"vow_clk_miso_off",
			"vow_clk_miso_on",
			"anc_dat_mosi_off",
			"anc_dat_mosi_on",
			"aud_smartpa_mode2";
	pinctrl-0 = <&aud_clk_mosi_off>;
	pinctrl-1 = <&aud_clk_mosi_on>;
	pinctrl-2 = <&aud_pins_smartpa_mode0>;
	pinctrl-3 = <&aud_pins_smartpa_mode1>;
	pinctrl-4 = <&aud_pins_smartpa_mode3>;
	pinctrl-5 = <&aud_pins_tdm_mode0>;
	pinctrl-6 = <&aud_pins_tdm_mode1>;
	pinctrl-7 = <&aud_pins_hpdepop_high>;
	pinctrl-8 = <&aud_pins_hpdepop_low>;
	pinctrl-9 = <&aud_dat_miso_off>;
	pinctrl-10 = <&aud_dat_miso_on>;
	pinctrl-11 = <&aud_dat_mosi_off>;
	pinctrl-12 = <&aud_dat_mosi_on>;
	pinctrl-13 = <&vow_dat_miso_off>;
	pinctrl-14 = <&vow_dat_miso_on>;
	pinctrl-15 = <&vow_clk_miso_off>;
	pinctrl-16 = <&vow_clk_miso_on>;
	pinctrl-17 = <&anc_dat_mosi_off>;
	pinctrl-18 = <&anc_dat_mosi_on>;
	/* MEIZU M80 Project */
	pinctrl-19 = <&aud_pins_smartpa_mode2>;
	/* MEIZU M80 Project */
	status = "okay";
};

&pio {
	aud_clk_mosi_off: aud_clk_mosi_off {
		pins_cmd0_dat {
			pins = <PINMUX_GPIO146__FUNC_GPIO146>;
		};
	};

	aud_clk_mosi_on: aud_clk_mosi_on {
		pins_cmd0_dat {
			pins = <PINMUX_GPIO146__FUNC_AUD_CLK_MOSI>;
		};
	};

	aud_pins_smartpa_mode0: aud_pins_smartpa_mode0 {
		pins_cmd0_dat {
			pins = <PINMUX_GPIO69__FUNC_GPIO69>;
		};
		pins_cmd1_dat {
			pins = <PINMUX_GPIO70__FUNC_GPIO70>;
		};
		pins_cmd2_dat {
			pins = <PINMUX_GPIO72__FUNC_GPIO72>;
		};
		pins_cmd3_dat {
			pins = <PINMUX_GPIO73__FUNC_GPIO73>;
		};
	};

	aud_pins_smartpa_mode1: aud_pins_smartpa_mode1 {
		pins_cmd0_dat {
			pins = <PINMUX_GPIO69__FUNC_I2S0_LRCK>;
		};
		pins_cmd1_dat {
			pins = <PINMUX_GPIO70__FUNC_I2S0_BCK>;
		};
		pins_cmd2_dat {
			pins = <PINMUX_GPIO72__FUNC_I2S0_DI>;
		};
		pins_cmd3_dat {
			pins = <PINMUX_GPIO73__FUNC_I2S3_DO>;
		};
	};

	aud_pins_smartpa_mode2: aud_pins_smartpa_mode2 {
		pins_cmd0_dat {
			pins = <PINMUX_GPIO69__FUNC_I2S3_LRCK>;
		};
		pins_cmd1_dat {
			pins = <PINMUX_GPIO70__FUNC_I2S3_BCK>;
		};
		pins_cmd2_dat {
			pins = <PINMUX_GPIO72__FUNC_I2S0_DI>;
		};
		pins_cmd3_dat {
			pins = <PINMUX_GPIO73__FUNC_I2S3_DO>;
		};
	};

	aud_pins_smartpa_mode3: aud_pins_smartpa_mode3 {
		pins_cmd0_dat {
			pins = <PINMUX_GPIO69__FUNC_I2S1_LRCK>;
		};
		pins_cmd1_dat {
			pins = <PINMUX_GPIO70__FUNC_I2S1_BCK>;
		};
		pins_cmd2_dat {
			pins = <PINMUX_GPIO72__FUNC_I2S2_DI>;
		};
		pins_cmd3_dat {
			pins = <PINMUX_GPIO73__FUNC_I2S1_DO>;
		};
	};

	aud_pins_tdm_mode0: aud_pins_tdm_mode0 {
	};

	aud_pins_tdm_mode1: aud_pins_tdm_mode1 {
	};

	aud_pins_hpdepop_high: audhpdepophigh {
		pins_cmd_dat {
			pins = <PINMUX_GPIO254__FUNC_GPIO254>;
			slew-rate = <1>;
			output-high;
		};
	};

	aud_pins_hpdepop_low: audhpdepoplow {
		pins_cmd_dat {
			pins = <PINMUX_GPIO254__FUNC_GPIO254>;
			slew-rate = <1>;
			output-low;
		};
	};

	aud_dat_miso_off: aud_dat_miso_off {
		pins_cmd1_dat {
			pins = <PINMUX_GPIO147__FUNC_GPIO147>;
		};
	};
	aud_dat_miso_on: aud_dat_miso_on {
		pins_cmd1_dat {
			pins = <PINMUX_GPIO147__FUNC_AUD_DAT_MISO>;
		};
	};

	aud_dat_mosi_off: aud_dat_mosi_off {
		pins_cmd2_dat {
			pins = <PINMUX_GPIO148__FUNC_GPIO148>;
		};
	};
	aud_dat_mosi_on: aud_dat_mosi_on {
		pins_cmd2_dat {
			pins = <PINMUX_GPIO148__FUNC_AUD_DAT_MOSI>;
		};
	};

	vow_dat_miso_off: vow_dat_miso_off {
		pins_cmd1_dat {
			pins = <PINMUX_GPIO147__FUNC_GPIO147>;
		};
	};
	vow_dat_miso_on: vow_dat_miso_on {
		pins_cmd1_dat {
			pins = <PINMUX_GPIO147__FUNC_VOW_DAT_MISO>;
		};
	};

	vow_clk_miso_off: vow_clk_miso_off {
		pins_cmd3_dat {
			pins = <PINMUX_GPIO149__FUNC_GPIO149>;
		};
	};
	vow_clk_miso_on: vow_clk_miso_on {
		pins_cmd3_dat {
			pins = <PINMUX_GPIO149__FUNC_VOW_CLK_MISO>;
		};
	};

	anc_dat_mosi_off: anc_dat_mosi_off {
		pins_cmd4_dat {
			pins = <PINMUX_GPIO150__FUNC_GPIO150>;
		};
	};
	anc_dat_mosi_on: anc_dat_mosi_on {
		pins_cmd4_dat {
			pins = <PINMUX_GPIO150__FUNC_ANC_DAT_MOSI>;
		};
	};
};

/* external amp support */
&i2c2 {
	tfa98xx_left: tfa98xx@34 {
		compatible = "nxp,tfa98xx";
		reg = <0x34>;
		nxp,tfa_max-vol-steps=<0x01>;
		reset-gpio = <&pio 255 0>;
		irq-gpio = <&pio 71 0>;
		pinctrl-names = "tfa_rst0", "tfa_rst1", "tfa_eint";
		pinctrl-0 = <&smartpa_pins_rst0>;
		pinctrl-1 = <&smartpa_pins_rst1>;
		pinctrl-2 = <&smartpa_pins_eint_as_int>;
		status = "okay";
	};
};

&pio {
	smartpa_pins_rst0: tfa@0 {
		pins_cmd_dat {
			pins = <PINMUX_GPIO255__FUNC_GPIO255>;
			slew-rate = <1>; /*direction 0:in, 1:out*/
			output-low;/*direction out used only. output_low or high*/
		};
	};

	smartpa_pins_rst1: tfa@1 {
		pins_cmd_dat {
			pins = <PINMUX_GPIO255__FUNC_GPIO255>;
			slew-rate = <1>; /*direction 0:in, 1:out*/
			output-high;
		};
	};

	smartpa_pins_eint_as_int: tfa@2 {
		pins_cmd_dat {
			pins = <PINMUX_GPIO71__FUNC_GPIO71>;
			slew-rate = <0>; /*direction 0:in, 1:out*/
			bias-disable;
		};
	};
};
/*added by ywl --end*/
/* AUDIO end */

/* DISPSYS GPIO start */
&mtkfb {
	pinctrl-names = "mode_te_gpio", "mode_te_te", "lcm_rst_out0_gpio",
			"lcm_rst_out1_gpio";
	pinctrl-0 = <&mtkfb_pins_mode_te_gpio>;
	pinctrl-1 = <&mtkfb_pins_mode_te_te>;
	pinctrl-2 = <&mtkfb_pins_lcm_reset0>;
	pinctrl-3 = <&mtkfb_pins_lcm_reset1>;
	
	vtouch-supply = <&tpvddi_gpio>;
	lcd_bias_enp-supply = <&lcd_bias_enp_gpio>;
	lcd_bias_enn-supply = <&lcd_bias_enn_gpio>;

	status = "okay";
};

&tpvddi_gpio{
	pinctrl-names = "on_cfg", "off_cfg";
	pinctrl-0 = <&mtkfb_pins_lcd_dvdd1v8_on>;
	pinctrl-1 = <&mtkfb_pins_lcd_dvdd1v8_off>;

	regulator-name = "tpvddi";
	regulator-min-microvolt = <1800000>;
	regulator-max-microvolt = <1800000>;
	regulator-ramp-delay = <250>;
	regulator-enable-ramp-delay = <180>;
	/*power on by lk*/
	regulator-boot-on = <1>;
};

&lcd_bias_enp_gpio {
	pinctrl-names = "on_cfg", "off_cfg";
	pinctrl-0 = <&mtkfb_pins_lcd_bias_enp1>;
	pinctrl-1 = <&mtkfb_pins_lcd_bias_enp0>;

	regulator-name = "lcd_enp";
	regulator-min-microvolt = <5800000>;
	regulator-max-microvolt = <5800000>;
	regulator-ramp-delay = <250>;
	regulator-enable-ramp-delay = <180>;
	/*power on by lk*/
	regulator-boot-on = <1>;
};

&lcd_bias_enn_gpio {
	pinctrl-names = "on_cfg", "off_cfg";
	pinctrl-0 = <&mtkfb_pins_lcd_bias_enn1>;
	pinctrl-1 = <&mtkfb_pins_lcd_bias_enn0>;

	regulator-name = "lcd_enn";
	regulator-min-microvolt = <5800000>;
	regulator-max-microvolt = <5800000>;
	regulator-ramp-delay = <250>;
	regulator-enable-ramp-delay = <180>;
	/*power on by lk*/
	regulator-boot-on = <1>;
};

&pio {

	mtkfb_pins_mode_te_gpio: mode_te_gpio {
		pins_cmd_dat {
			pins = <PINMUX_GPIO179__FUNC_DSI_TE0>;
		};
	};

	mtkfb_pins_mode_te_te: mode_te_te {
		pins_cmd_dat {
			pins = <PINMUX_GPIO179__FUNC_DSI_TE0>;
		};
	};

	mtkfb_pins_lcm_reset0: lcm_rst_out0_gpio {
		pins_cmd_dat {
			pins = <PINMUX_GPIO180__FUNC_GPIO180>;
			slew-rate = <1>;
			output-low;
		};
	};

	mtkfb_pins_lcm_reset1: lcm_rst_out1_gpio {
		pins_cmd_dat {
			pins = <PINMUX_GPIO180__FUNC_GPIO180>;
			slew-rate = <1>;
			output-high;
		};
	};

	mtkfb_pins_lcd_bias_enp0: lcd_bias_enp0_gpio {
		pins_cmd_dat {
			pins = <PINMUX_GPIO252__FUNC_GPIO252>;
			slew-rate = <1>;
			output-low;
		};
	};

	mtkfb_pins_lcd_bias_enp1: lcd_bias_enp1_gpio {
		pins_cmd_dat {
			pins = <PINMUX_GPIO252__FUNC_GPIO252>;
			slew-rate = <1>;
			output-high;
		};
	};

	mtkfb_pins_lcd_dvdd1v8_on: lcd_dvdd1v8_on_gpio {
		pins_cmd_dat {
			pins = <PINMUX_GPIO201__FUNC_GPIO201>;
			slew-rate = <1>;
			output-high;
		};
	};

	mtkfb_pins_lcd_dvdd1v8_off: lcd_dvdd1v8_off_gpio {
		pins_cmd_dat {
			pins = <PINMUX_GPIO201__FUNC_GPIO201>;
			slew-rate = <1>;
			output-low;
		};
	};

	mtkfb_pins_lcd_bias_enn0: lcd_bias_enn0_gpio {
		pins_cmd_dat {
			pins = <PINMUX_GPIO251__FUNC_GPIO251>;
			slew-rate = <1>;
			output-low;
		};
	};

	mtkfb_pins_lcd_bias_enn1: lcd_bias_enn1_gpio {
		pins_cmd_dat {
			pins = <PINMUX_GPIO251__FUNC_GPIO251>;
			slew-rate = <1>;
			output-high;
		};
	};
};
/* DISPSYS GPIO end */


/* CAMERA GPIO standardization */
&pio {
	camera_pins_cam0_rst0: cam0@0 {
		pins_cmd_dat {
			pins = <PINMUX_GPIO33__FUNC_GPIO33>;
			slew-rate = <1>; /*direction 0:in, 1:out*/
			output-low;/*direction out used only. output_low or high*/
		};
	};
	camera_pins_cam0_rst1: cam0@1 {
		pins_cmd_dat {
			pins = <PINMUX_GPIO33__FUNC_GPIO33>;
			slew-rate = <1>;
			output-high;
		};
	};
	camera_pins_cam0_laser0: cam0@2 {
		pins_cmd_dat {
			pins = <PINMUX_GPIO140__FUNC_GPIO140>;
			slew-rate = <1>;
			output-low;
		};
	};
	camera_pins_cam0_laser1: cam0@3 {
		pins_cmd_dat {
			pins = <PINMUX_GPIO140__FUNC_GPIO140>;
			slew-rate = <1>;
			output-high;
		};
	};
	camera_pins_cam1_rst0: cam1@0 {
		pins_cmd_dat {
			pins = <PINMUX_GPIO35__FUNC_GPIO35>;
			slew-rate = <1>; /*direction 0:in, 1:out*/
			output-low;/*direction out used only. output_low or high*/
		};
	};
	camera_pins_cam1_rst1: cam1@1 {
		pins_cmd_dat {
			pins = <PINMUX_GPIO35__FUNC_GPIO35>;
			slew-rate = <1>;
			output-high;
		};
	};
	camera_pins_cam_ldo_vcama_0: cam0@vcama0 {
		pins_cmd_dat {
			pins = <PINMUX_GPIO30__FUNC_GPIO30>;
			slew-rate = <1>;
			output-low;
		};
	};
	camera_pins_cam_ldo_vcama_1: cam1@vcama1 {
		pins_cmd_dat {
			pins = <PINMUX_GPIO30__FUNC_GPIO30>;
			slew-rate = <1>;
			output-high;
		};
	};
	camera_pins_default: camdefault {
	};
};

&kd_camera_hw1 {
	pinctrl-names = "default",
			"cam0_rst0", "cam0_rst1", "cam0_laser0", "cam0_laser1",
			"cam1_rst0", "cam1_rst1", 
			"cam_ldo_vcama_0", "cam_ldo_vcama_1";
	pinctrl-0 = <&camera_pins_default>;
	pinctrl-1 = <&camera_pins_cam0_rst0>;
	pinctrl-2 = <&camera_pins_cam0_rst1>;
	pinctrl-3 = <&camera_pins_cam0_laser0>;
	pinctrl-4 = <&camera_pins_cam0_laser1>;
	pinctrl-5 = <&camera_pins_cam1_rst0>;
	pinctrl-6 = <&camera_pins_cam1_rst1>;
	/* for ldo control by gpio */
	pinctrl-7 = <&camera_pins_cam_ldo_vcama_0>;
	pinctrl-8 = <&camera_pins_cam_ldo_vcama_1>;
	status = "okay";
};
/* CAMERA GPIO end */

/* CONSYS GPIO standardization */
&pio {
	consys_pins_default:consys_pins_default {

	};

	gpslna_pins_init: gpslna@0 {

	    pins_cmd_dat {
			pins = <PINMUX_GPIO141__FUNC_GPIO141>;
			slew-rate = <0>;
			bias-disable;
			output-low;
		};
	};

	gpslna_pins_oh: gpslna@1 {

	    pins_cmd_dat {
			pins = <PINMUX_GPIO141__FUNC_GPIO141>;
			slew-rate = <1>;
			output-high;
		};
	};

	gpslna_pins_ol: gpslna@2 {

	    pins_cmd_dat {
			pins = <PINMUX_GPIO141__FUNC_GPIO141>;
			slew-rate = <1>;
			output-low;
		};
	};

};

&consys {
	pinctrl-names = "default", "gps_lna_state_init", "gps_lna_state_oh", "gps_lna_state_ol";
	pinctrl-0 = <&consys_pins_default>;
	pinctrl-1 = <&gpslna_pins_init>;
	pinctrl-2 = <&gpslna_pins_oh>;
	pinctrl-3 = <&gpslna_pins_ol>;
	status = "okay";

};
/* CONSYS end */

/* FLASHLIGHT GPIO standardization */
&pio {
	flashlight_pins_default: flashlight_pins_default {

	};

	flashlight_pins_hwen_high: hwen_high {

	    pins_cmd_dat {
			pins = <PINMUX_GPIO194__FUNC_GPIO194>;
			slew-rate = <1>;
			output-high;
		};
	};

	flashlight_pins_hwen_low: hwen_low {

	    pins_cmd_dat {
			pins = <PINMUX_GPIO194__FUNC_GPIO194>;
			slew-rate = <1>;
			output-low;
		};
	};
	flashlight_pins_torch_high: torch_high {

	    pins_cmd_dat {
			pins = <PINMUX_GPIO214__FUNC_GPIO214>;
			slew-rate = <1>;
			output-high;
		};
	};

	flashlight_pins_torch_low: torch_low {

	    pins_cmd_dat {
			pins = <PINMUX_GPIO214__FUNC_GPIO214>;
			slew-rate = <1>;
			output-low;
		};
	};
	flashlight_pins_flash_high: flash_high {

	    pins_cmd_dat {
			pins = <PINMUX_GPIO208__FUNC_GPIO208>;
			slew-rate = <1>;
			output-high;
		};
	};

	flashlight_pins_flash_low: flash_low {

	    pins_cmd_dat {
			pins = <PINMUX_GPIO208__FUNC_GPIO208>;
			slew-rate = <1>;
			output-low;
		};
	};

};

&flashlight {
	pinctrl-names = "default", "hwen_high", "hwen_low", "torch_high", "torch_low", "flash_high", "flash_low";
	pinctrl-0 = <&flashlight_pins_default>;
	pinctrl-1 = <&flashlight_pins_hwen_high>;
	pinctrl-2 = <&flashlight_pins_hwen_low>;
	pinctrl-3 = <&flashlight_pins_torch_high>;
	pinctrl-4 = <&flashlight_pins_torch_low>;
	pinctrl-5 = <&flashlight_pins_flash_high>;
	pinctrl-6 = <&flashlight_pins_flash_low>;
	flashid_gpio = <&pio 248 0>;
	status = "okay";

};
/* FLASHLIGHT GPIO end */

/* USB XHCI GPIO start */
&pio {
	iddig_default: iddig_default {
	};

	gpio181_mode1_iddig: iddig_init {
		pins_cmd_dat {
			pins = <PINMUX_GPIO181__FUNC_IDDIG>;
			slew-rate = <0>;
			bias-pull-up = <00>;
		};
	};
};

&pio {
	drvvbus_default: drvvbus_default {
	};

	gpio94_mode1_drvvbus_low: drvvbus_low {
		pins_cmd_dat {
			pins = <PINMUX_GPIO94__FUNC_USB_DRVVBUS>;
			slew-rate = <1>;
			output-low;
		};
	};

	gpio94_mode1_drvvbus_high: drvvbus_high {
		pins_cmd_dat {
			pins = <PINMUX_GPIO94__FUNC_USB_DRVVBUS>;
			slew-rate = <1>;
			output-high;
		};
	};
};

&usb0 {
	pinctrl-names = "iddig_default", "iddig_init";
	pinctrl-0 = <&iddig_default>;
	pinctrl-1 = <&gpio181_mode1_iddig>;
	status = "okay";
};

&xhci0 {
	pinctrl-names = "drvvbus_default", "drvvbus_low", "drvvbus_high";
	pinctrl-0 = <&drvvbus_default>;
	pinctrl-1 = <&gpio94_mode1_drvvbus_low>;
	pinctrl-2 = <&gpio94_mode1_drvvbus_high>;
	status = "okay";
};

/* bq2589x charger dts config */
&pio {
		/* bq2589x main charger dis gpio */
        chg0_dis_pins_low_cfg: chg0_dis_low_cfg {
                pins_cmd_dat {
                        pins = <PINMUX_GPIO243__FUNC_GPIO243>;
                        slew-rate = <1>;
                        output-low;
                };
        };
        chg0_dis_pins_high_cfg: chg0_dis_high_cfg {
                pins_cmd_dat {
                        pins = <PINMUX_GPIO243__FUNC_GPIO243>;
                        slew-rate = <1>;
                        output-high;
                };
        };
		/* bq2589x 2nd charger dis gpio */
        chg1_dis_pins_low_cfg: chg1_dis_low_cfg {
                pins_cmd_dat {
                        pins = <PINMUX_GPIO242__FUNC_GPIO242>;
                        slew-rate = <1>;
                        output-low;
                };
        };
        chg1_dis_pins_high_cfg: chg1_dis_high_cfg {
                pins_cmd_dat {
                        pins = <PINMUX_GPIO242__FUNC_GPIO242>;
                        slew-rate = <1>;
                        output-high;
                };
        };

};

/* bq25892 charger start */
&i2c0 {
        #address-cells = <1>;
        #size-cells = <0>;
        clock-frequency = <100000>;
        mediatek,use-open-drain;
        bq2589x_main@6b {
            compatible = "mediatek,bq2589x_main";
            reg = <0x6b>;
            status = "okay";
		    pinctrl-names = 
                        "chg0_dis_low_cfg",
                        "chg0_dis_high_cfg",
                        "chg1_dis_low_cfg",
                        "chg1_dis_high_cfg";

		    pinctrl-0 = <&chg0_dis_pins_low_cfg>;
		    pinctrl-1 = <&chg0_dis_pins_high_cfg>;
		    pinctrl-2 = <&chg1_dis_pins_low_cfg>;
		    pinctrl-3 = <&chg1_dis_pins_high_cfg>;
       };
		/*bq27532 battery*/
		bq27532@55 {
			compatible = "mediatek,bq27532";
			reg = <0x55>;
			status = "okay";
		};
		/*muic*/
		tsu6721@25 {
			compatible = "mediatek,tsu6721";
			reg = <0x25>;
			status = "okay";
		};
		/*lcd power & backlight*/
		lcd_bl_bias@11 {
			compatible = "mediatek,lcd_bl_bias";
			reg = <0x11>;
			status = "okay";
		};
		/*usb typec fusb301a*/
		fusb301a_type_c: fusb301a_type_c@21{
			compatible = "mediatek,fusb301a_type_c";
			reg = <0x21>;
			status = "okay";
		};
		/*usb typec tusb3200*/
		tusb320_type_c: tusb320_type_c@60{
			compatible = "mediatek,tusb320_type_c";
			reg = <0x47>;
			status = "okay";
		};

};

/* USB TYPEC GPIO start */
&pio {
	usb_typec_default: usb_typec_default {
	};

	usb_typec_eint_init: usb_typec_eint_init {
		pins_cmd_dat {
			pins = <PINMUX_GPIO210__FUNC_GPIO210>;
			slew-rate = <0>;
			bias-pull-up = <00>;
		};
	};

	usb_typec_en_low: usb_typec_en_low {
		pins_cmd_dat {
			pins = <PINMUX_GPIO205__FUNC_GPIO205>;
			slew-rate = <1>;
			output-low;
		};
	};

	usb_typec_en_high: usb_typec_en_high {
		pins_cmd_dat {
			pins = <PINMUX_GPIO205__FUNC_GPIO205>;
			slew-rate = <1>;
			output-high;
		};
	};
};

&usb_c_pinctrl {
	pinctrl-names = "default",
		"eint_init",
		"gpio_en_low",
		"gpio_en_high";

	pinctrl-0 = <&usb_typec_default>;
	pinctrl-1 = <&usb_typec_eint_init>;
	pinctrl-2 = <&usb_typec_en_low>;
	pinctrl-3 = <&usb_typec_en_high>;
	status = "okay";
};

/* USB TYPEC GPIO end */

&i2c5 {
        bq2589x_sub@6b {
                compatible = "mediatek,bq2589x_sed";
                reg = <0x6b>;
                status = "okay";
        };
};
/* bq25892 charger end */

/* SPI GPIO standardization */
&pio {
	/* SPI GPIO Settings - Start */

	/* SPI1: cs set, cs clear, clk set, clk clear
			miso set, miso clear, mosi set, mosi clear*/
		spi1_gpio_def_cfg:spi1_gpio_default{

	};
	spi1_cs_set_cfg:spi1_cs_set@gpio237{
		pins_cmd_dat {
			pins = <PINMUX_GPIO237__FUNC_SPI1_CS_B>;
			input-enable;
		};
	};
	spi1_cs_clr_cfg:spi1_cs_clear@gpio237{
		pins_cmd_dat {
			pins = <PINMUX_GPIO237__FUNC_GPIO237>;
			slew-rate = <0>;
			input-disable;
			bias-disable;
			input-schmitt-enable;
		};
	};
	spi1_clk_set_cfg:spi1_clk_set@gpio234{
		pins_cmd_dat {
			pins = <PINMUX_GPIO234__FUNC_SPI1_CLK_B>;
			input-enable;
		};
	};
	spi1_clk_clr_cfg:spi1_clk_clear@gpio234{
		pins_cmd_dat {
			pins = <PINMUX_GPIO234__FUNC_GPIO234>;
			slew-rate = <0>;
			input-disable;
			bias-disable;
			input-schmitt-enable;
		};
	};
	spi1_miso_set_cfg:spi1_miso_set@gpio235{
		pins_cmd_dat {
			pins = <PINMUX_GPIO235__FUNC_SPI1_MI_B>;
			input-enable;
		};
	};
	spi1_miso_clr_cfg:spi1_miso_clear@gpio235{
		pins_cmd_dat {
			pins = <PINMUX_GPIO235__FUNC_GPIO235>;
			slew-rate = <0>;
			input-disable;
			bias-disable;
			input-schmitt-enable;
		};
	};
	spi1_mosi_set_cfg:spi1_mosi_set@gpio236{
		pins_cmd_dat {
			pins = <PINMUX_GPIO236__FUNC_SPI1_MO_B>;
			input-enable;
		};
	};
	spi1_mosi_clr_cfg:spi1_mosi_clear@gpio236{
		pins_cmd_dat {
			pins = <PINMUX_GPIO236__FUNC_GPIO236>;
			slew-rate = <0>;
			input-disable;
			bias-disable;
			input-schmitt-enable;
		};
	};
	/* SPI GPIO Settings - End */
};

&spi1{
	pinctrl-names = "spi1_gpio_def",
				"spi1_cs_set",
				"spi1_cs_clr",
				"spi1_clk_set",
				"spi1_clk_clr",
				"spi1_miso_set",
				"spi1_miso_clr",
				"spi1_mosi_set",
				"spi1_mosi_clr";
	pinctrl-0 = <&spi1_gpio_def_cfg>;
	pinctrl-1 = <&spi1_cs_set_cfg>;
	pinctrl-2 = <&spi1_cs_clr_cfg>;
	pinctrl-3 = <&spi1_clk_set_cfg>;
	pinctrl-4 = <&spi1_clk_clr_cfg>;
	pinctrl-5 = <&spi1_miso_set_cfg>;
	pinctrl-6 = <&spi1_miso_clr_cfg>;
	pinctrl-7 = <&spi1_mosi_set_cfg>;
	pinctrl-8 = <&spi1_mosi_clr_cfg>;
	status = "okay";
};
/* SPI END */

/* SCP GPIO standardization */

&pio {
	scp_dvfs_default: scp_dvfs_default {
	};
	scp_aud_clk_mosi_off: scp_gpio_off {
		pins_cmd_dat {
			pins = <PINMUX_GPIO146__FUNC_GPIO146>;
		};
	};

	scp_aud_clk_mosi_on: scp_gpio_on {
		pins_cmd_dat {
			pins = <PINMUX_GPIO146__FUNC_AUD_CLK_MOSI>;
		};
	};
};

&scpdvfs {
	pinctrl-names = "default", "scp_gpio_off", "scp_gpio_on";
	pinctrl-0 = <&scp_dvfs_default>;
	pinctrl-1 = <&scp_aud_clk_mosi_off>;
	pinctrl-2 = <&scp_aud_clk_mosi_on>;
	status = "okay";
};

/* SCP DVFS GPIO end */

/* Motor drv260x dts config */
&pio {
        motor_pins_low_cfg: low_cfg {
                pins_cmd_dat {
                        pins = <PINMUX_GPIO29__FUNC_GPIO29>;
                        slew-rate = <1>;
                        output-low;
                };
        };
        motor_pins_high_cfg: high_cfg {
                pins_cmd_dat {
                        pins = <PINMUX_GPIO29__FUNC_GPIO29>;
                        slew-rate = <1>;
                        output-high;
                };
        };
        motor_pins_default: motor_pins_default {
        };
};

&i2c5 {
        motor@5a {
		compatible = "mediatek,motor";
		reg = <0x5a>;
		status = "okay";
		pinctrl-names = "default", "low_cfg", "high_cfg";
		pinctrl-0 = <&motor_pins_default>;
		pinctrl-1 = <&motor_pins_low_cfg>;
		pinctrl-2 = <&motor_pins_high_cfg>;
        };
};
/* Motor drv260x end */
/* DA9214 GPIO Start */
&ext_buck_vproc {
	pinctrl-names = "da9214_gpio_default";
	pinctrl-0 = <&da9214_gpio_default>;
	status = "okay";
};

&pio {
	/* DA9214 GPIO Settings -Start */
	/* default: GPIO61, output, low */
	da9214_gpio_default:da9214_gpio_def@gpio61 {
		pins_cmd_dat {
			pins = <PINMUX_GPIO61__FUNC_GPIO61>;
			slew-rate = <0>;
			bias-pull-up = <00>;
			input-schmitt-enable = <0>;
		};
	};
	/* DA9214 GPIO Settings -End */
};
/* DA9214 GPIO End */

/*VGPU Buck Start */
&i2c7{
	rt5735_buck@1c {
		compatible = "mediatek,rt5735";
		reg = <0x1c>;
		regulator-name = "vgpu_buck_rt5735";
		regulator-min-microvolt = <600000>;
		regulator-max-microvolt = <1393750>;
		regulator-ramp-delay = <32000>;
		regulator-enable-ramp-delay = <800>;
		status = "okay";
	};
	fan53200_buck@60 {
		compatible = "mediatek,fan53200";
		reg = <0x60>;
		regulator-name = "vgpu_buck_fan53200";
		regulator-min-microvolt = <600000>;
		regulator-max-microvolt = <1387500>;
		regulator-ramp-delay = <32000>;
		regulator-enable-ramp-delay = <800>;
		status = "okay";
	};
};
/* VGPU Buck End */

/* MEIZU Product test: check sim card slot start */
&pio {
	set_sim1_gpio_default: set_sim1_gpio_default {
	};

	set_sim1_gpio_mode: sim1_gpio_mode {
		pins_cmd_dat {
			pins = <PINMUX_GPIO112__FUNC_GPIO112>;
			slew-rate = <0>;
			bias-pull-up = <00>;
		};
	};
	set_back_sim1_eint_mode: sim1_eint_mode {
		pins_cmd_dat {
			pins = <PINMUX_GPIO112__FUNC_MD_INT1_C2K_UIM1_HOT_PLUG_IN>;
			slew-rate = <0>;
			bias-pull-up = <00>;
		};
	};
};

&check_sim_slot {
	pinctrl-names = "default", "sim1_gpio_mode", "sim1_eint_mode";
	pinctrl-0 = <&set_sim1_gpio_default>;
	pinctrl-1 = <&set_sim1_gpio_mode>;
	pinctrl-2 = <&set_back_sim1_eint_mode>;
	status = "okay";
};
/* MEIZU Product test: check sim card slot end */

&i2c1 {

    apds9922:apds9922@53 {
        compatible = "mediatek,apds9922";
		tpvddi-supply = <&tpvddi_gpio>;
        interrupt-parent = <&eintc>;
        interrupts = <85 IRQ_TYPE_EDGE_FALLING>;
        debounce = <85 0>;
        gpio = < 85 >;
        reg = <0x53>;
        status = "okay";
    };
	
    lsm6ds3:lsm6ds3@6a {
        compatible = "mediatek,lsm6ds3";
        interrupt-parent = <&eintc>;
        interrupts = <63 IRQ_TYPE_EDGE_RISING>;
        debounce = <63 0>;

        reg = <0x6a>;
        status = "okay";
    };
};

