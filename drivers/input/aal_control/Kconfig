## drivers/input/aal_control/Kconfig
```kconfig
#
# Input misc drivers configuration
#
config AAL_CONTROL
	tristate "AAL Control for AAL DRE feature"
	default n
	help
	  Say Y to enable support AAL control driver.
```

## drivers/input/bh1745/Kconfig
```kconfig
#
# Input misc drivers configuration
#
menuconfig M95M_SENSOR
	bool "MEIZU_ALS_PS_SENSOR bh sensor"
	help
	  Say Y here, and a list of miscellaneous input drivers will be displayed.
	  Everything that didn't fit into the other categories is here. This option
	  doesn't affect the kernel.

if M95M_SENSOR
config INPUT_ALSPS_BH1745
	tristate "BH ALSPS BH1745"
	depends on INPUT && I2C
	default y
	help
	  Say Y to enable support for the AWAGO ALSPS APDS9922 driver.
endif
```

## drivers/misc/mediatek/boost_regulator/Kconfig
```kconfig
# Boost Regulator driver

# Mediatek Boost Regulator driver
config MTK_BOOST_REGULATOR
	tristate "MediaTek Boost Regulator Driver"
	default n
	---help---
	  Mediatek Boost Regulator Driver
```

## drivers/misc/mediatek/fingerprint/Kconfig
```kconfig
source "drivers/misc/mediatek/fingerprint/fpc_ree/Kconfig"
source "drivers/misc/mediatek/fingerprint/goodix_tee/Kconfig"
source "drivers/misc/mediatek/fingerprint/goodix_ree/Kconfig"
```

## drivers/misc/mediatek/fingerprint/fpc_ree/Kconfig
```kconfig
#
# Tablet driver configuration
#

config FINGERPRINT_FPC1150
	tristate "FPC1150 fingerprint"
	depends on SPI_MASTER
	help
	  Say Y here if you have a fingerprint interface using the
	  FPC1150 controller, and your board-specific initialization
	  code includes that in its table of SPI devices.

	  If unsure, say N (but it's safe to say "Y").

	  To compile this driver as a module, choose M here: the
	  module will be called FPC1150.
```

## drivers/misc/mediatek/fingerprint/goodix_ree/Kconfig
```kconfig
config FINGERPRINT_GOODIX_REE
  bool FINGERPRINT_GOODIX_REE
  default n
  help
    Goodix Fingerprint chip GF516/GF318GF316M/GF516M/GF616M/GF318M REE driver
```

## drivers/misc/mediatek/fingerprint/goodix_tee/Kconfig
```kconfig
config FINGERPRINT_GOODIX_TEE
  bool FINGERPRINT_GOODIX_TEE
  default y
  help
    Goodix Fingerprint chip GF516/GF318GF316M/GF516M/GF616M/GF318M TEE driver
```

## drivers/misc/mediatek/thermal/usb_thermal/Kconfig
```kconfig
config M95M_USB_THERMAL
	bool "CONFIG_M95M_USB_THERMAL"
	default y
	help
	  thermal for m95m usb

config USB_COOLING_DEVICE_DEBUG
	bool "CONFIG_USB_COOLING_DEVICE_DEBUG"
	depends on M95M_USB_THERMAL
	default n
	help
	   usb cooling device debug.
```

## drivers/misc/meizu/Kconfig
```kconfig
#
# Meizu Framework configuration
#
menu "Meizu Framework"

config MEIZU_SENSOR
	tristate "Meizu Sensor Framework Support"
	select IIO_TRIGGERED_BUFFER
	help
	  Enable meizu sensor framework support

source "drivers/misc/meizu/sensor/Kconfig"
endmenu
```

## drivers/misc/meizu/sensor/Kconfig
```kconfig
#
# Meizu Sensor Framework configuration
#
menu "Meizu Sensor"

source "drivers/misc/meizu/sensor/adaptor/Kconfig"
source "drivers/misc/meizu/sensor/chips/Kconfig"
endmenu
```

## drivers/misc/meizu/sensor/adaptor/Kconfig
```kconfig
#
# Meizu Sensor Chips configuration
#
menu "Meizu Sensor Adaptors"

source "drivers/misc/meizu/sensor/adaptor/light/Kconfig"
source "drivers/misc/meizu/sensor/adaptor/pressure/Kconfig"
source "drivers/misc/meizu/sensor/adaptor/proximity/Kconfig"
source "drivers/misc/meizu/sensor/adaptor/sensorhub/Kconfig"
source "drivers/misc/meizu/sensor/adaptor/temperature/Kconfig"

endmenu
```

## drivers/misc/meizu/sensor/adaptor/light/Kconfig
```kconfig
#
# Meizu Sensor Chips configuration
#
menu "Meizu Sensor ALS Adaptor"

config MEIZU_SENSOR_ALS_ADAPTOR
	tristate "Meizu ALS Sensor Adattor Support"
	help
	  Enable Meizu ALS Sensor Adattor Support

endmenu
```

## drivers/misc/meizu/sensor/adaptor/pressure/Kconfig
```kconfig
#
# Meizu Sensor Chips configuration
#
menu "Meizu Sensor PRES Adaptor"

config MEIZU_SENSOR_PRES_ADAPTOR
	tristate "Meizu PRES Sensor Adattor Support"
	help
	  Enable Meizu PRES Sensor Adattor Support

endmenu
```

## drivers/misc/meizu/sensor/adaptor/proximity/Kconfig
```kconfig
#
# Meizu Sensor Chips configuration
#
menu "Meizu Sensor PS Adaptor"

config MEIZU_SENSOR_PS_ADAPTOR
	tristate "Meizu PS Sensor Adattor Support"
	help
	  Enable Meizu PS Sensor Adattor Support

endmenu
```

## drivers/misc/meizu/sensor/adaptor/sensorhub/Kconfig
```kconfig
#
# Meizu Sensor Chips configuration
#
menu "Meizu Sensor Hub Adaptor"

source "drivers/misc/meizu/sensor/adaptor/sensorhub/mtk/Kconfig"

endmenu
```

## drivers/misc/meizu/sensor/adaptor/sensorhub/mtk/Kconfig
```kconfig
#
# Meizu Sensor Chips configuration
#
menu "Meizu Sensor MTK SCP ADAPTOR"

config MEIZU_SENSOR_MTK_SCP_ACC_ADAPTOR
	tristate "Meizu PRES Sensor Adattor Support"
	help
	  Enable Meizu PRES Sensor Adattor Support

config MEIZU_SENSOR_MTK_SCP_MAG_ADAPTOR
	tristate "Meizu PRES Sensor Adattor Support"
	help
	  Enable Meizu PRES Sensor Adattor Support

config MEIZU_SENSOR_MTK_SCP_PRES_ADAPTOR
	tristate "Meizu PRES Sensor Adattor Support"
	help
	  Enable Meizu PRES Sensor Adattor Support
endmenu
```

## drivers/misc/meizu/sensor/adaptor/temperature/Kconfig
```kconfig
#
# Meizu Sensor Chips configuration
#
menu "Meizu Sensor Adaptors"

config MEIZU_SENSOR_ALS_ADAPTOR
	tristate "Meizu ALS Sensor Adattor Support"
	help
	  Enable Meizu ALS Sensor Adattor Support

config MEIZU_SENSOR_PS_ADAPTOR
	tristate "Meizu PS Sensor Adattor Support"
	help
	  Enable Meizu PS Sensor Adattor Support

config MEIZU_SENSOR_PRES_ADAPTOR
	tristate "Meizu PRES Sensor Adattor Support"
	help
	  Enable Meizu PRES Sensor Adattor Support

source "drivers/misc/meizu/sensor/adaptor/sensorhub/Kconfig"

endmenu
```

## drivers/misc/meizu/sensor/chips/Kconfig
```kconfig
#
# Meizu Sensor Chips configuration
#
menu "Meizu Sensor Chips"

source "drivers/misc/meizu/sensor/chips/acc-gyr-mtk-lsm6ds3/Kconfig"
source "drivers/misc/meizu/sensor/chips/als-isl29125/Kconfig"
source "drivers/misc/meizu/sensor/chips/mag-mtk-akm0991x/Kconfig"
source "drivers/misc/meizu/sensor/chips/pres-lps25/Kconfig"
source "drivers/misc/meizu/sensor/chips/pres-mtk-lps25/Kconfig"
source "drivers/misc/meizu/sensor/chips/ps-pa224/Kconfig"

endmenu
```

## drivers/misc/meizu/sensor/chips/acc-gyr-mtk-lsm6ds3/Kconfig
```kconfig
#
# Meizu Sensor Chips configuration
#
menu "Meizu Sensor Chip - LSM6DS3"

config MEIZU_SENSOR_ACC_GYR_MTK_LSM6DS3
	tristate "ST LSM6DS3 ACC GYR Support"
	depends on MEIZU_SENSOR
	select MEIZU_SENSOR_MTK_SCP_ACC_ADAPTOR
	help
	  Enable ST LPS25 PRES Support

endmenu
```

## drivers/misc/meizu/sensor/chips/als-isl29125/Kconfig
```kconfig
#
# Meizu Sensor Chips configuration
#
menu "Meizu Sensor Chip - ISL29125"

config MEIZU_SENSOR_ALS_ISL29125
	tristate "Intersil ISL29125 ALS Support"
	depends on MEIZU_SENSOR
	select MEIZU_SENSOR_ALS_ADAPTOR
	help
	  Enable Intersil ISL29125 ALS support

endmenu
```

## drivers/misc/meizu/sensor/chips/mag-mtk-akm0991x/Kconfig
```kconfig
#
# Meizu Sensor Chips configuration
#
menu "Meizu Sensor Chip - AKM0991x"

config MEIZU_SENSOR_MAG_MTK_AKM0991X
	tristate "AKM0991x MAG Support"
	depends on MEIZU_SENSOR
	select MEIZU_SENSOR_MTK_SCP_MAG_ADAPTOR
	help
	  Enable ST LPS25 PRES Support

endmenu
```

## drivers/misc/meizu/sensor/chips/pres-lps25/Kconfig
```kconfig
#
# Meizu Sensor Chips configuration
#
menu "Meizu Sensor Chip - LPS25"

config MEIZU_SENSOR_PRES_LPS25
	tristate "ST LPS25 PRES Support"
	depends on MEIZU_SENSOR
	select MEIZU_SENSOR_PRES_ADAPTOR
	help
	  Enable ST LPS25 PRES Support

endmenu
```

## drivers/misc/meizu/sensor/chips/ps-pa224/Kconfig
```kconfig
#
# Meizu Sensor Chips configuration
#
menu "Meizu Sensor Chip - PA224"

config MEIZU_SENSOR_PS_PA224
	tristate "TXC PA224 PS Support"
	depends on MEIZU_SENSOR
	select MEIZU_SENSOR_PS_ADAPTOR
	help
	  Enable TXC PA224 PS Support

endmenu
```

## drivers/misc/motor/Kconfig
```kconfig
#
# motor devices
#

menu "Motor Ti drv2605 drivers"
	depends on ANDROID_TIMED_OUTPUT

config MOTOR_DRV2605
	bool "drv2605 motor driver"
	depends on ANDROID_TIMED_OUTPUT
	default n

endmenu
```

## sound/soc/tfa98xx/Kconfig
```kconfig
config SND_SOC_TFA98XX
	tristate "SoC Audio for nxp tfa98xx series"
	depends on I2C
	help
	  This option enables support for tfa98xx series Smart PA.
```
